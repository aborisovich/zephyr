## boards/xtensa/intel_adsp_ace15_mtpm/Kconfig.board
```kconfig
# Xtensa board configuration

# Copyright (c) 2022 Intel Corporation
# SPDX-License-Identifier: Apache-2.0

config  BOARD_INTEL_ADSP_MTL
	bool "Intel ADSP MTL"
	depends on SOC_SERIES_INTEL_ACE1X
```

## boards/xtensa/intel_adsp_mtl/Kconfig.board
```kconfig
# Xtensa board configuration

# Copyright (c) 2020 Intel Corporation
# SPDX-License-Identifier: Apache-2.0

config  BOARD_INTEL_ADSP_MTL
	bool "Intel ADSP MTL"
	depends on SOC_SERIES_INTEL_ACE1X


config  BOARD_INTEL_ADSP_MTL_SIM
	bool "Intel ADSP MTL"
	depends on SOC_SERIES_INTEL_ACE1X
```

## boards/xtensa/intel_adsp_mtl/Kconfig.defconfig
```kconfig
# Copyright (c) 2020 Intel Corporation
#
# SPDX-License-Identifier: Apache-2.0

if BOARD_INTEL_ADSP_MTL

config BOARD
	default "intel_adsp_mtl"

endif # BOARD_INTEL_ADSP_MTL

if BOARD_INTEL_ADSP_MTL_SIM

config BOARD
	default "intel_adsp_mtl_sim"

endif # BOARD_INTEL_ADSP_MTL_SIM
```

## soc/xtensa/intel_adsp/Kconfig.soc
```kconfig
# Intel CAVS SoC series selection
#
# Copyright (c) 2020 Intel Corporation
# SPDX-License-Identifier: Apache-2.0

rsource "*/Kconfig.series"
rsource "*/Kconfig.soc"
```

## soc/xtensa/intel_adsp/mtl/Kconfig.defconfig.series
```kconfig
# Copyright (c) 2020 Intel Corporation
# SPDX-License-Identifier: Apache-2.0

if SOC_SERIES_INTEL_ACE1X

config SOC_SERIES
	string
	default "mtl"

config SOC_TOOLCHAIN_NAME
	string
	default "intel_s1000"

config SOC
	string
	default "intel_mtl"

config IMR_MANIFEST_ADDR
	default 0xa1042000

config MP_NUM_CPUS
	default 3

config SMP
       default y

# MTL leaves the upper mapping in the same spot as cAVS, but moves the
# lower one inexplicably.
config XTENSA_UNCACHED_REGION
	default 2

# Parameters for gen_isr_tables.py:

config MULTI_LEVEL_INTERRUPTS
	default y
config MAX_IRQ_PER_AGGREGATOR
	default 29
config 2ND_LVL_ISR_TBL_OFFSET
        default 9
config 2ND_LEVEL_INTERRUPTS
	default y

config XTENSA_TIMER
	default n

config XTENSA_TIMER_ID
	default 0

config MTL_TIMER
	default y

config SYS_CLOCK_HW_CYCLES_PER_SEC
        default 400000000 if XTENSA_TIMER
        default 24000000 if MTL_TIMER

config SYS_CLOCK_TICKS_PER_SEC
	default 50000

config IRQ_OFFLOAD_INTNUM
	default 0

config DYNAMIC_INTERRUPTS
	default y

# To prevent test uses TEST_LOGGING_MINIMAL
config TEST_LOGGING_DEFAULTS
	default n
	depends on TEST

if LOG

config LOG_BACKEND_ADSP
	default y

endif # LOG

endif # SOC_SERIES_INTEL_ACE1X
```

## soc/xtensa/intel_adsp/mtl/Kconfig.series
```kconfig
# Copyright (c) 2021 Intel Corporation
# SPDX-License-Identifier: Apache-2.0

config SOC_SERIES_INTEL_MTL
	bool "Intel MTL"
	select SOC_FAMILY_INTEL_ADSP
	select XTENSA
	select XTENSA_HAL if "$(ZEPHYR_TOOLCHAIN_VARIANT)" != "xcc"
	select ATOMIC_OPERATIONS_BUILTIN if "$(ZEPHYR_TOOLCHAIN_VARIANT)" != "xcc"
	select ARCH_HAS_COHERENCE
	select SCHED_IPI_SUPPORTED
	help
	  Intel MTL
```

## soc/xtensa/intel_adsp/mtl/Kconfig.soc
```kconfig
# Copyright (c) 2020 Intel Corporation
# SPDX-License-Identifier: Apache-2.0

choice
	prompt "Intel ADSP SoC Selection"

	config SOC_INTEL_MTL
		bool "Meteor Lake SoC"
		depends on SOC_SERIES_INTEL_MTL

endchoice
```
