/*
 * Copyright (c) 2022 Intel Corporation
 *
 * SPDX-License-Identifier: Apache-2.0
 */

/dts-v1/;

#include <intel/intel_adsp_ace15_mtpm.dtsi>

/ {
	model = "intel_adsp_ace15_mtpm";
	compatible = "intel";

	chosen {
		zephyr,sram = &sram0;
	};
};
